## meta-gpsnavi-agl/conf/layer.conf
```bitbake
# We have a conf and classes directory, append to BBPATH
BBPATH .= ":${LAYERDIR}"

# We have a recipes directory, add to BBFILES
BBFILES += "${LAYERDIR}/recipes*/*/*.bb ${LAYERDIR}/recipes*/*/*.bbappend"

BBFILE_COLLECTIONS += "meta-gpsnavi-agl"
BBFILE_PATTERN_meta-gpsnavi-agl := "^${LAYERDIR}/"
BBFILE_PRIORITY_meta-gpsnavi-agl = "16"
```

## meta-hitachi/conf/layer.conf
```bitbake
# We have a conf and classes directory, append to BBPATH
BBPATH .= ":${LAYERDIR}"

# We have a recipes directory, add to BBFILES
BBFILES += "${LAYERDIR}/recipes*/*/*.bb ${LAYERDIR}/recipes*/*/*.bbappend"

BBFILE_COLLECTIONS += "meta-hitachi"
BBFILE_PATTERN_meta-hitachi := "^${LAYERDIR}/"
BBFILE_PRIORITY_meta-hitachi = "16"
```
